/dts-v1/;

/include/ "msm8953.dtsi"
/include/ "msm8953_huawei_common.dtsi"

/ {
	model = "Huawei Technologies, Inc. CAN-AL00";
	compatible = "huawei,CAN-AL00", "qcom,msm8953", "lk2nd,device";https://github.com/bzy-080408/lk2nd-hwcan/blob/main/dts/can-al00-va.dts
	qcom,board-id= <8019 0>;
};
