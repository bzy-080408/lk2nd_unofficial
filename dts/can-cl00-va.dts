/dts-v1/;

/include/ "msm8953.dtsi"
/include/ "msm8953_huawei_common.dtsi"

/ {
	model = "Huawei Technologies, Inc. CAN-CL00";
	compatible = "huawei,CAN-AL00", "qcom,msm8953", "lk2nd,device";
	qcom,board-id= <8018 0>;
};
