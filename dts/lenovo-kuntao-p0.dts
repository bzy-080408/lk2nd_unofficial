/dts-v1/;

/include/ "msm8953.dtsi"

/ {
	model = "Kuntao";
	compatible = "lenovo,Kuntao", "qcom,msm8953", "lk2nd,device";
	qcom,msm-id = <293 0x0>;
	qcom,board-id= <0x41 0x82b1>, <0x41 0x83b0>;  //for dvt2-2,pvt...
};

