/dts-v1/;

/include/ "msm8953.dtsi"

/ {
	model = "Kuntao";
	compatible = "lenovo,Kuntao", "qcom,msm8953", "lk2nd,device";
	qcom,msm-id = <293 0x0>;
	qcom,board-id= <0x41 0x80a0>, <0x41 0x80b0>, <0x41 0x81b0>, <0x41 0x82b0>;
};

