/dts-v1/;

/include/ "msm8953.dtsi"
/include/ "msm8953_huawei_common.dtsi"

/ {
	model = "Huawei Technologies, Inc. MLA-AL00";
	compatible = "huawei,MLA-AL00", "qcom,msm8953", "lk2nd,device";
	qcom,board-id= <8017 0>;
};
