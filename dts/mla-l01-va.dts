/dts-v1/;

/include/ "msm8953.dtsi"
/include/ "msm8953_huawei_common.dtsi"

/ {
	model = "Huawei Technologies, Inc. MLA-L01";
	compatible = "huawei,MLA-L01", "qcom,msm8953", "lk2nd,device";
	qcom,board-id= <8048 0>;
};
