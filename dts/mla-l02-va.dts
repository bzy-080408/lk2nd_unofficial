/dts-v1/;

/include/ "msm8953.dtsi"
/include/ "msm8953_huawei_common.dtsi"

/ {
	model = "Huawei Technologies, Inc. MLA-L02";
	compatible = "huawei,MLA-L02", "qcom,msm8953", "lk2nd,device";
	qcom,board-id= <8064 0>;
};
