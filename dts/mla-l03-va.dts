/dts-v1/;

/include/ "msm8953.dtsi"
/include/ "msm8953_huawei_common.dtsi"

/ {
	model = "Huawei Technologies, Inc. MLA-L03";
	compatible = "huawei,MLA-L03", "qcom,msm8953", "lk2nd,device";
	qcom,board-id= <8080 0>;
};
