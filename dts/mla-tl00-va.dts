/dts-v1/;

/include/ "msm8953.dtsi"
/include/ "msm8953_huawei_common.dtsi"

/ {
	model = "Huawei Technologies, Inc. MLA-TL00";
	compatible = "huawei,MLA-TL0p", "qcom,msm8953", "lk2nd,device";
	qcom,board-id= <8032 0>;
};
